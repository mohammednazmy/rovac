## hardware/bno055_test/sdkconfig.defaults
```kconfig
# ESP32 DevKitV1 (WROOM-32, CP2102 USB-serial)
CONFIG_IDF_TARGET="esp32"

# Flash
CONFIG_ESPTOOLPY_FLASHSIZE_4MB=y
CONFIG_ESPTOOLPY_FLASHMODE_DIO=y
CONFIG_ESPTOOLPY_FLASHFREQ_40M=y

# Log level
CONFIG_LOG_DEFAULT_LEVEL_INFO=y
```

## hardware/esp32_lidar_wireless/main/Kconfig.projbuild
```kconfig
menu "ROVAC LIDAR Wireless Configuration"

    config LIDAR_WIRELESS_DEFAULT_WIFI_SSID
        string "Default WiFi SSID"
        default "Hurry"

    config LIDAR_WIRELESS_DEFAULT_WIFI_PASS
        string "Default WiFi Password"
        default "Gaza@2023"

    config LIDAR_WIRELESS_DEFAULT_WIFI_IP
        string "Default Static IP"
        default "192.168.1.222"

    config LIDAR_WIRELESS_DEFAULT_AGENT_IP
        string "Default micro-ROS Agent IP"
        default "192.168.1.200"

    config LIDAR_WIRELESS_DEFAULT_AGENT_PORT
        int "Default micro-ROS Agent UDP port"
        default 8888

    config LIDAR_WIRELESS_DEFAULT_GATEWAY_IP
        string "Default network gateway IP"
        default "192.168.1.254"

    config LIDAR_WIRELESS_DEFAULT_NETMASK
        string "Default subnet mask"
        default "255.255.255.0"

    config LIDAR_WIRELESS_DEFAULT_TARGET_RPM
        int "Default target LIDAR RPM"
        default 300
        range 200 400

endmenu
```

## hardware/esp32_lidar_wireless/sdkconfig.defaults
```kconfig
# ESP32-S3 WROOM (Lonely Binary, USB-C CDC, 16MB flash, 8MB OPI PSRAM)
# LIDAR Wireless defaults

# Target
CONFIG_IDF_TARGET="esp32s3"

# Flash — 16MB QIO 80MHz
CONFIG_ESPTOOLPY_FLASHSIZE_16MB=y
CONFIG_ESPTOOLPY_FLASHMODE_DIO=y
CONFIG_ESPTOOLPY_FLASHFREQ_80M=y

# Partition table — custom CSV
CONFIG_PARTITION_TABLE_CUSTOM=y
CONFIG_PARTITION_TABLE_CUSTOM_FILENAME="partitions.csv"

# FreeRTOS — 1000Hz tick, dual-core
CONFIG_FREERTOS_HZ=1000
CONFIG_FREERTOS_UNICORE=n

# WiFi
CONFIG_ESP_WIFI_STATIC_RX_BUFFER_NUM=10
CONFIG_ESP_WIFI_DYNAMIC_RX_BUFFER_NUM=32
CONFIG_ESP_WIFI_DYNAMIC_TX_BUFFER_NUM=32
CONFIG_ESP_WIFI_TX_BUFFER_TYPE=1

# Console via USB Serial/JTAG (USB-C CDC on Lonely Binary boards)
CONFIG_ESP_CONSOLE_USB_SERIAL_JTAG=y

# Log level — INFO
CONFIG_LOG_DEFAULT_LEVEL_INFO=y
CONFIG_LOG_DEFAULT_LEVEL=3

# Watchdog — Task WDT at 15s
CONFIG_ESP_TASK_WDT_TIMEOUT_S=15

# Disable bootloader WDT in user code (fires at 9s, interferes with WiFi wait)
CONFIG_BOOTLOADER_WDT_DISABLE_IN_USER_CODE=y

# Panic handler — print + delay before reboot so we can see crash messages
CONFIG_ESP_SYSTEM_PANIC_PRINT_REBOOT=y
CONFIG_ESP_SYSTEM_PANIC_REBOOT_DELAY_SECONDS=5

# Stack overflow detection
CONFIG_COMPILER_STACK_CHECK_MODE_NORM=y

# UART ISR in IRAM
CONFIG_UART_ISR_IN_IRAM=y

# Newlib — nano printf (saves flash)
CONFIG_NEWLIB_NANO_FORMAT=y

# micro-ROS — WiFi UDP transport to Agent on Pi
CONFIG_MICRO_ROS_ESP_XRCE_DDS_MIDDLEWARE=y
CONFIG_MICRO_ROS_ESP_NETIF_WLAN=y
CONFIG_ESP_WIFI_SSID="Hurry"
CONFIG_ESP_WIFI_PASSWORD="Gaza@2023"
CONFIG_ESP_MAXIMUM_RETRY=5
CONFIG_MICRO_ROS_AGENT_IP="192.168.1.200"
CONFIG_MICRO_ROS_AGENT_PORT="8888"
```

## hardware/esp32_motor_wireless/main/Kconfig.projbuild
```kconfig
menu "ROVAC Motor Wireless Configuration"

    config MOTOR_WIRELESS_DEFAULT_WIFI_SSID
        string "Default WiFi SSID"
        default "Hurry"

    config MOTOR_WIRELESS_DEFAULT_WIFI_PASS
        string "Default WiFi Password"
        default "Gaza@2023"

    config MOTOR_WIRELESS_DEFAULT_WIFI_IP
        string "Default Static IP"
        default "192.168.1.221"

    config MOTOR_WIRELESS_DEFAULT_AGENT_IP
        string "Default micro-ROS Agent IP"
        default "192.168.1.200"

    config MOTOR_WIRELESS_DEFAULT_AGENT_PORT
        int "Default micro-ROS Agent UDP port"
        default 8888

    config MOTOR_WIRELESS_DEFAULT_GATEWAY_IP
        string "Default network gateway IP"
        default "192.168.1.254"

    config MOTOR_WIRELESS_DEFAULT_NETMASK
        string "Default subnet mask"
        default "255.255.255.0"

endmenu
```

## hardware/esp32_motor_wireless/sdkconfig.defaults
```kconfig
# ESP32-WROOM-32E (Maker ESP32) — Motor Serial defaults
# Flash: 4MB DIO, No PSRAM, UART0 binary protocol (CH340)

# Target
CONFIG_IDF_TARGET="esp32"

# Flash
CONFIG_ESPTOOLPY_FLASHSIZE_4MB=y
CONFIG_ESPTOOLPY_FLASHMODE_DIO=y
CONFIG_ESPTOOLPY_FLASHFREQ_40M=y

# No PSRAM on WROOM-32E
CONFIG_SPIRAM=n

# Partition table — custom CSV
CONFIG_PARTITION_TABLE_CUSTOM=y
CONFIG_PARTITION_TABLE_CUSTOM_FILENAME="partitions.csv"

# FreeRTOS — 1000Hz tick, dual-core
CONFIG_FREERTOS_HZ=1000
CONFIG_FREERTOS_UNICORE=n

# Console via UART0 (bootloader only — firmware takes over UART0 for binary protocol)
CONFIG_ESP_CONSOLE_UART_DEFAULT=y

# Log level — INFO (routed through MSG_LOG binary frames after serial_transport_init)
CONFIG_LOG_DEFAULT_LEVEL_INFO=y
CONFIG_LOG_DEFAULT_LEVEL=3

# Watchdog
CONFIG_ESP_TASK_WDT_TIMEOUT_S=10

# UART ISR in IRAM (critical for serial performance)
CONFIG_UART_ISR_IN_IRAM=y

# Newlib — nano printf (saves flash)
CONFIG_NEWLIB_NANO_FORMAT=y
```

## hardware/esp32_sensor_hub/sdkconfig.defaults
```kconfig
# ESP32-WROOM-32 (DevKitV1) — Sensor Hub defaults
# Flash: 4MB DIO, No PSRAM, UART0 binary protocol (CP2102)

# Target
CONFIG_IDF_TARGET="esp32"

# Flash
CONFIG_ESPTOOLPY_FLASHSIZE_4MB=y
CONFIG_ESPTOOLPY_FLASHMODE_DIO=y
CONFIG_ESPTOOLPY_FLASHFREQ_40M=y

# No PSRAM on WROOM-32
CONFIG_SPIRAM=n

# FreeRTOS — 1000Hz tick for microsecond-precision timing
CONFIG_FREERTOS_HZ=1000
CONFIG_FREERTOS_UNICORE=n

# Console via UART0 (bootloader only — firmware takes over for binary protocol)
CONFIG_ESP_CONSOLE_UART_DEFAULT=y

# Log level — INFO (routed through MSG_LOG binary frames after serial init)
CONFIG_LOG_DEFAULT_LEVEL_INFO=y
CONFIG_LOG_DEFAULT_LEVEL=3

# Watchdog
CONFIG_ESP_TASK_WDT_TIMEOUT_S=10

# UART ISR in IRAM
CONFIG_UART_ISR_IN_IRAM=y

# Newlib — nano printf (saves flash)
CONFIG_NEWLIB_NANO_FORMAT=y
```
