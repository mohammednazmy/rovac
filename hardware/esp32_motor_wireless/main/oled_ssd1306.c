/*
 * oled_ssd1306.c — Minimal SSD1306 128x32 I2C OLED driver
 *
 * Framebuffer approach: 512-byte buffer (128×32/8), flushed via I2C.
 * SSD1306 page format: each byte = 8 vertical pixels, LSB at top.
 * Includes embedded 5x7 ASCII font (printable chars 0x20–0x7E).
 */
#include "oled_ssd1306.h"
#include "driver/i2c.h"
#include "esp_log.h"
#include <string.h>

static const char *TAG = "oled";

#define I2C_NUM     I2C_NUM_0
#define I2C_FREQ_HZ 400000
#define FB_SIZE     (OLED_WIDTH * OLED_HEIGHT / 8)  /* 512 bytes */

static uint8_t s_fb[FB_SIZE];

/* ── 5x7 ASCII font (chars 0x20–0x7E, 95 glyphs × 5 bytes = 475 bytes) ── */
/* Each glyph: 5 columns left→right, each byte bit0=top .. bit6=bottom      */
static const uint8_t font5x7[][5] = {
    {0x00,0x00,0x00,0x00,0x00}, /*   */
    {0x00,0x00,0x5F,0x00,0x00}, /* ! */
    {0x00,0x07,0x00,0x07,0x00}, /* " */
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    {0x10,0x08,0x08,0x10,0x08}, /* ~ */
};

/* ── I2C helpers ─────────────────────────────────────────────────────────── */

static esp_err_t oled_write_cmd(uint8_t cmd)
{
    uint8_t buf[2] = {0x00, cmd};  /* Co=0, D/C#=0 (command) */
    return i2c_master_write_to_device(I2C_NUM, OLED_I2C_ADDR,
                                       buf, sizeof(buf),
                                       pdMS_TO_TICKS(50));
}

static esp_err_t oled_write_cmds(const uint8_t *cmds, size_t len)
{
    for (size_t i = 0; i < len; i++) {
        esp_err_t rc = oled_write_cmd(cmds[i]);
        if (rc != ESP_OK) return rc;
    }
    return ESP_OK;
}

/* ── Public API ──────────────────────────────────────────────────────────── */

esp_err_t oled_init(void)
{
    /* Configure I2C master */
    i2c_config_t conf = {
        .mode = I2C_MODE_MASTER,
        .sda_io_num = OLED_SDA_PIN,
        .scl_io_num = OLED_SCL_PIN,
        .sda_pullup_en = GPIO_PULLUP_ENABLE,
        .scl_pullup_en = GPIO_PULLUP_ENABLE,
        .master.clk_speed = I2C_FREQ_HZ,
    };
    esp_err_t rc = i2c_param_config(I2C_NUM, &conf);
    if (rc != ESP_OK) return rc;
    rc = i2c_driver_install(I2C_NUM, I2C_MODE_MASTER, 0, 0, 0);
    if (rc != ESP_OK) return rc;

    /* SSD1306 init sequence for 128x32 */
    static const uint8_t init_cmds[] = {
        0xAE,       /* display off */
        0xD5, 0x80, /* set clock divide ratio */
        0xA8, 0x1F, /* set multiplex ratio = 31 (32 lines) */
        0xD3, 0x00, /* set display offset = 0 */
        0x40,       /* set start line = 0 */
        0x8D, 0x14, /* charge pump ON (internal VCC) */
        0x20, 0x00, /* horizontal addressing mode */
        0xA1,       /* segment remap (flip horizontal) */
        0xC8,       /* COM scan direction (flip vertical) */
        0xDA, 0x02, /* COM pins config for 128x32 */
        0x81, 0x8F, /* set contrast */
        0xD9, 0xF1, /* set pre-charge period */
        0xDB, 0x40, /* set VCOMH deselect level */
        0xA4,       /* display follows RAM */
        0xA6,       /* normal display (not inverted) */
        0xAF,       /* display ON */
    };
    rc = oled_write_cmds(init_cmds, sizeof(init_cmds));
    if (rc != ESP_OK) {
        ESP_LOGE(TAG, "SSD1306 init failed (rc=%d) — OLED not connected?", rc);
        return rc;
    }

    oled_clear();
    oled_update();
    ESP_LOGI(TAG, "SSD1306 128x32 initialized (I2C addr 0x%02X)", OLED_I2C_ADDR);
    return ESP_OK;
}

void oled_clear(void)
{
    memset(s_fb, 0, sizeof(s_fb));
}

static inline void set_pixel(int x, int y)
{
    if (x < 0 || x >= OLED_WIDTH || y < 0 || y >= OLED_HEIGHT) return;
    s_fb[x + (y / 8) * OLED_WIDTH] |= (1 << (y & 7));
}

void oled_draw_text(int x, int y, const char *text, int scale)
{
    if (scale < 1) scale = 1;

    for (int i = 0; text[i] != '\0'; i++) {
        uint8_t c = (uint8_t)text[i];
        if (c < 0x20 || c > 0x7E) c = '?';
        const uint8_t *glyph = font5x7[c - 0x20];

        for (int col = 0; col < 5; col++) {
            uint8_t column_data = glyph[col];
            for (int row = 0; row < 7; row++) {
                if (column_data & (1 << row)) {
                    /* Draw scaled pixel block */
                    for (int sy = 0; sy < scale; sy++)
                        for (int sx = 0; sx < scale; sx++)
                            set_pixel(x + col * scale + sx,
                                      y + row * scale + sy);
                }
            }
        }
        x += (5 + 1) * scale;  /* 5-pixel glyph + 1-pixel gap, scaled */
    }
}

void oled_update(void)
{
    /* Set column and page address to cover full display */
    static const uint8_t addr_cmds[] = {
        0x21, 0x00, 0x7F,  /* column address 0–127 */
        0x22, 0x00, 0x03,  /* page address 0–3 (4 pages for 32 rows) */
    };
    oled_write_cmds(addr_cmds, sizeof(addr_cmds));

    /* Send framebuffer as data (0x40 prefix = data stream) */
    uint8_t buf[FB_SIZE + 1];
    buf[0] = 0x40;  /* Co=0, D/C#=1 (data) */
    memcpy(&buf[1], s_fb, FB_SIZE);
    i2c_master_write_to_device(I2C_NUM, OLED_I2C_ADDR,
                                buf, sizeof(buf),
                                pdMS_TO_TICKS(100));
}
